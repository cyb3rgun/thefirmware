## targets/cambench/main/Kconfig.projbuild
```kconfig
menu "CYB3RGUN camera bench"

config CGCAM_CLOCK_HZ
    int "SPI clock in Hz"
    range 100000 14000000
    default 1000000
    help
        The part does 14 MHz on a board, but its pins drive 4 mA into a
        specified 100 pF, so flying wires get 1 to 2 MHz. concept.md
        section 5.

config CGCAM_FPS
    int "Frames per second the bench reads at"
    range 1 200
    default 50
    help
        S01-B01 task 5 asks for 50. The part itself does up to 200.

config CGCAM_PRINT_HZ
    int "Lines per second on the serial port"
    range 1 50
    default 2
    help
        The frame loop runs at the full rate so the timing is real. Printing
        every frame at 50 fps would make the port the bottleneck rather than
        the sensor, so only some frames are printed.

endmenu
```

## targets/module/main/Kconfig.projbuild
```kconfig
menu "CYB3RGUN module"

config CGMODULE_CHANNEL
    int "Fixed 2.4 GHz channel"
    range 1 13
    default 1
    help
        The room's channel, concept.md principle 4. The core overrides it
        with the channel message and the value is kept in NVS, so this is
        only the value a freshly erased board starts on. It must match the
        channel of the pistols.

config CGMODULE_SLOT
    int "This target's slot in the room plan"
    range 0 32
    default 1
    help
        Slots are counted from 1. The core overrides this with the beacons
        message. A pistol that identified no beacons sends slot 0, which
        every module acknowledges and forwards as unaimed.

config CGBEACON_SLOTS
    int "Targets sharing one multiplex period"
    range 1 32
    default 4
    help
        usb-protocol.md gives the module a slot and a period but no slot
        count, so the count is set here. The multiplex window is the period
        divided by this number. See D-009.

config CGMODULE_STATUS_PERIOD_S
    int "Seconds between status messages"
    range 1 3600
    default 30
    help
        usb-protocol.md section 3: status on request and every 30 s.

endmenu
```

## targets/pistolstub/main/Kconfig.projbuild
```kconfig
menu "CYB3RGUN pistol stub"

config CGPISTOL_CHANNEL
    int "Fixed 2.4 GHz channel"
    range 1 13
    default 1
    help
        Must match the module's channel. The module keeps its channel in
        NVS and takes it from the core; the stub has no core, so it is set
        here.

config CGPISTOL_SLOT
    int "Slot this stub aims at"
    range 0 32
    default 1
    help
        The multiplex slot the pistol believes it identified. 0 means no
        beacons were identified, which every module acknowledges and
        forwards as unaimed.

config CGPISTOL_AUTOFIRE
    bool "Fire on a timer as well as on the button"
    default y
    help
        A bench run needs a steady stream of shots. Turn this off to fire
        only with the PRG button.

config CGPISTOL_RATE_MS
    int "Milliseconds between shots when firing on the timer"
    range 10 60000
    default 200
    help
        200 ms is five shots a second, so a run of 100 shots takes about
        twenty seconds.

config CGPISTOL_ACK_TIMEOUT_MS
    int "Milliseconds to wait for the module's acknowledgement"
    range 2 1000
    default 20
    help
        concept.md principle 1 puts the radio round trip in single digit
        milliseconds, so 20 ms is generous and still lets all four
        transmissions of one shot finish inside 80 ms.

config CGPISTOL_RUN_SHOTS
    int "Shots per run, 0 to never summarise"
    range 0 100000
    default 100
    help
        The summary is printed when the run completes. S01-B01 asks for
        100 shots per distance.

config CGPISTOL_TRACE
    bool "Print one line per shot"
    default n
    help
        Useful when a single exchange misbehaves, too noisy for a run.

endmenu
```
